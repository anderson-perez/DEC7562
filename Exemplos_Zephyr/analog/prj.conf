## CMakeLists.txt
```
# SPDX-License-Identifier: Apache-2.0

cmake_minimum_required(VERSION 3.20.0)

find_package(Zephyr REQUIRED HINTS $ENV{ZEPHYR_BASE})
project(digital_io)

target_sources(app PRIVATE src/main.c)
```

## prj.conf
```kconfig
CONFIG_GPIO=y
CONFIG_ADC=y
```

## app.overlay
```dts
#include <zephyr/dt-bindings/adc/adc.h>

/ {
    zephyr,user {
        io-channels = <&adc0 6>;
    };
};

&adc0 {
    status = "okay";

    #address-cells = <1>;
    #size-cells = <0>;

    channel@6 {
        reg = <6>;
        zephyr,gain = "ADC_GAIN_1_4";
        zephyr,reference = "ADC_REF_INTERNAL";
        zephyr,acquisition-time = <ADC_ACQ_TIME_DEFAULT>;
        zephyr,resolution = <12>;
    };
};
```

## src/main.c
```c
#include <zephyr/kernel.h>
#include <zephyr/device.h>
#include <zephyr/drivers/adc.h>

#define ADC_NODE DT_PATH(zephyr_user)

static const struct adc_dt_spec adc_ldr = ADC_DT_SPEC_GET_BY_IDX(ADC_NODE, 0);

int main()
{
    int16_t buffer;

    struct adc_sequence seq = {.buffer = &buffer,
                               .buffer_size = sizeof(buffer)};

    if (!adc_is_ready_dt(&adc_ldr)) return 0;
    
    adc_channel_setup_dt(&adc_ldr);

    while (1) {
        adc_sequence_init_dt(&adc_ldr, &seq);
        adc_read_dt(&adc_ldr, &seq);
        printf("Valor lido...: %d\n", buffer);
        k_msleep(300);
    }

    return 0;
}
```
